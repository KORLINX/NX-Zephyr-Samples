## CMakeLists.txt
```
# SPDX-License-Identifier: Apache-2.0

cmake_minimum_required(VERSION 3.20.0)

# Make the repo-root custom boards (nx15, nx40) discoverable.
list(APPEND BOARD_ROOT ${CMAKE_CURRENT_SOURCE_DIR}/../..)

find_package(Zephyr REQUIRED HINTS $ENV{ZEPHYR_BASE})
project(gatt)

target_sources(app PRIVATE src/main.c src/gatt_svc.c)
zephyr_library_include_directories(.)
```

## Kconfig
```
#
# Copyright (c) 2026 Korlinx
#
# SPDX-License-Identifier: Apache-2.0
#

mainmenu "Korlinx custom GATT notify sample"

config GATT_NOTIFY_INTERVAL_MS
	int "Counter notification interval in milliseconds"
	default 3000
	help
	  Period between counter notifications sent to a subscribed client.
	  The one-byte counter also advances at this rate when nobody is
	  subscribed.

source "Kconfig.zephyr"
```

## sample.yaml
```
sample:
  name: Custom GATT notify
  description: |
    BLE peripheral exposing a custom 128-bit GATT service with a single
    Notify characteristic. Once a client (e.g. the nRF Connect app)
    subscribes, an incrementing one-byte counter is notified every 3
    seconds.
tests:
  sample.korlinx.gatt.build:
    build_only: true
    tags: bluetooth
    platform_allow:
      - nx15/nrf54l15/cpuapp
      - nx40/nrf52840
```

## prj.conf
```kconfig
CONFIG_BT=y
CONFIG_BT_PERIPHERAL=y
CONFIG_BT_DEVICE_NAME="Korlinx_NX_GATT"
# Per-board overrides live in boards/<board>.conf (e.g. Korlinx_NX15_GATT, Korlinx_NX40_GATT)

CONFIG_LOG=y
CONFIG_LOG_BACKEND_UART=y
```

## boards/nx15_nrf54l15_cpuapp.conf
```kconfig
CONFIG_BT_DEVICE_NAME="Korlinx_NX15_GATT"
```

## boards/nx40_nrf52840.conf
```kconfig
CONFIG_BT_DEVICE_NAME="Korlinx_NX40_GATT"
```

## src/main.c
```c
/*
 * Copyright (c) 2026 Korlinx
 *
 * SPDX-License-Identifier: Apache-2.0
 */

#include <zephyr/kernel.h>
#include <zephyr/bluetooth/bluetooth.h>
#include <zephyr/bluetooth/conn.h>
#include <zephyr/bluetooth/uuid.h>
#include <zephyr/logging/log.h>
#include "gatt_svc.h"

LOG_MODULE_REGISTER(gatt, LOG_LEVEL_INF);

#define DEVICE_NAME     CONFIG_BT_DEVICE_NAME
#define DEVICE_NAME_LEN (sizeof(DEVICE_NAME) - 1)

/* Advertised so nRF Connect can filter for this device by service UUID. */
#define BT_UUID_KORLINX_SVC_VAL \
	BT_UUID_128_ENCODE(0x4b4f524c, 0x0001, 0x494e, 0x585f, 0x475054000001)

/* Connectable advertising with a fast interval. */
static const struct bt_le_adv_param *adv_param =
	BT_LE_ADV_PARAM(BT_LE_ADV_OPT_CONN,
			BT_GAP_ADV_FAST_INT_MIN_2,
			BT_GAP_ADV_FAST_INT_MAX_2,
			NULL);

static const struct bt_data ad[] = {
	BT_DATA_BYTES(BT_DATA_FLAGS, (BT_LE_AD_GENERAL | BT_LE_AD_NO_BREDR)),
	BT_DATA(BT_DATA_NAME_COMPLETE, DEVICE_NAME, DEVICE_NAME_LEN),
};

static const struct bt_data sd[] = {
	BT_DATA_BYTES(BT_DATA_UUID128_ALL, BT_UUID_KORLINX_SVC_VAL),
};

static void notify_work_handler(struct k_work *work);
static K_WORK_DELAYABLE_DEFINE(notify_work, notify_work_handler);

static void advertising_start(void)
{
	int err = bt_le_adv_start(adv_param, ad, ARRAY_SIZE(ad), sd, ARRAY_SIZE(sd));

	if (err) {
		LOG_ERR("Advertising failed to start (err %d)", err);
		return;
	}
	LOG_INF("Advertising as \"%s\"", DEVICE_NAME);
}

/* Fires every CONFIG_GATT_NOTIFY_INTERVAL_MS. The counter advances regardless
 * of whether a client is subscribed; counter_notify() only hits the radio when
 * it is.
 */
static void notify_work_handler(struct k_work *work)
{
	static uint8_t counter;
	int err = counter_notify(counter);

	if (err == 0) {
		LOG_INF("Notified counter = %u", counter);
	} else if (err == -ENOTCONN) {
		LOG_DBG("No subscriber; counter = %u (not sent)", counter);
	} else {
		LOG_WRN("Notify failed (err %d); counter = %u", err, counter);
	}

	counter++;
	k_work_reschedule(&notify_work, K_MSEC(CONFIG_GATT_NOTIFY_INTERVAL_MS));
}

static void connected(struct bt_conn *conn, uint8_t err)
{
	if (err) {
		LOG_ERR("Connection failed (err 0x%02x)", err);
		return;
	}
	LOG_INF("Connected");
}

static void disconnected(struct bt_conn *conn, uint8_t reason)
{
	LOG_INF("Disconnected (reason 0x%02x)", reason);
}

static void recycled(void)
{
	/* Connection object freed after a disconnect — advertise again. */
	advertising_start();
}

BT_CONN_CB_DEFINE(conn_callbacks) = {
	.connected = connected,
	.disconnected = disconnected,
	.recycled = recycled,
};

int main(void)
{
	int err;

	LOG_INF("Starting Korlinx custom GATT notify sample on %s", CONFIG_BOARD_TARGET);

	err = bt_enable(NULL);
	if (err) {
		LOG_ERR("Bluetooth init failed (err %d)", err);
		return 0;
	}
	LOG_INF("Bluetooth initialized");

	advertising_start();

	/* Kick off the notify loop. */
	k_work_schedule(&notify_work, K_MSEC(CONFIG_GATT_NOTIFY_INTERVAL_MS));

	return 0;
}
```

## src/gatt_svc.c
```c
/*
 * Copyright (c) 2026 Korlinx
 *
 * SPDX-License-Identifier: Apache-2.0
 */

#include <errno.h>

#include <zephyr/bluetooth/bluetooth.h>
#include <zephyr/bluetooth/gatt.h>
#include <zephyr/bluetooth/uuid.h>
#include <zephyr/logging/log.h>

#include "gatt_svc.h"

LOG_MODULE_DECLARE(gatt, LOG_LEVEL_INF);

/* Vendor 128-bit UUIDs (see gatt_svc.h). */
#define BT_UUID_KORLINX_SVC_VAL \
	BT_UUID_128_ENCODE(0x4b4f524c, 0x0001, 0x494e, 0x585f, 0x475054000001)
#define BT_UUID_KORLINX_COUNTER_VAL \
	BT_UUID_128_ENCODE(0x4b4f524c, 0x0002, 0x494e, 0x585f, 0x475054000001)

static const struct bt_uuid_128 korlinx_svc_uuid =
	BT_UUID_INIT_128(BT_UUID_KORLINX_SVC_VAL);
static const struct bt_uuid_128 korlinx_counter_uuid =
	BT_UUID_INIT_128(BT_UUID_KORLINX_COUNTER_VAL);

/* Latest counter value — kept so a plain GATT read returns something useful. */
static uint8_t counter_value;
/* Set when a client writes the CCC to enable notifications. */
static bool notify_enabled;

static void counter_ccc_changed(const struct bt_gatt_attr *attr, uint16_t value)
{
	notify_enabled = (value == BT_GATT_CCC_NOTIFY);
	LOG_INF("Notifications %s", notify_enabled ? "enabled" : "disabled");
}

static ssize_t read_counter(struct bt_conn *conn, const struct bt_gatt_attr *attr,
			    void *buf, uint16_t len, uint16_t offset)
{
	return bt_gatt_attr_read(conn, attr, buf, len, offset,
				 &counter_value, sizeof(counter_value));
}

/* attrs[0] service, attrs[1] characteristic decl, attrs[2] value, attrs[3] CCC. */
BT_GATT_SERVICE_DEFINE(korlinx_svc,
	BT_GATT_PRIMARY_SERVICE(&korlinx_svc_uuid),
	BT_GATT_CHARACTERISTIC(&korlinx_counter_uuid.uuid,
			       BT_GATT_CHRC_READ | BT_GATT_CHRC_NOTIFY,
			       BT_GATT_PERM_READ,
			       read_counter, NULL, &counter_value),
	BT_GATT_CCC(counter_ccc_changed,
		    BT_GATT_PERM_READ | BT_GATT_PERM_WRITE),
);

int counter_notify(uint8_t value)
{
	counter_value = value;

	if (!notify_enabled) {
		return -ENOTCONN;
	}

	/* Passing the characteristic declaration attr notifies its value. */
	return bt_gatt_notify(NULL, &korlinx_svc.attrs[1],
			      &counter_value, sizeof(counter_value));
}
```

## src/gatt_svc.h
```c
/*
 * Copyright (c) 2026 Korlinx
 *
 * SPDX-License-Identifier: Apache-2.0
 */

#ifndef GATT_SVC_H_
#define GATT_SVC_H_

#include <stdint.h>

/*
 * Custom Korlinx notify service — vendor 128-bit UUIDs.
 * Service : 4b4f524c-0001-494e-585f-475054000001
 * Counter : 4b4f524c-0002-494e-585f-475054000001  (Read + Notify)
 */

/**
 * Update the counter characteristic value and, if a client has enabled
 * notifications, notify it.
 *
 * The value is always stored (so a GATT read returns the latest value),
 * regardless of whether anyone is subscribed.
 *
 * @param value  Byte to publish.
 *
 * @retval 0          Notified successfully.
 * @retval -ENOTCONN  No client has enabled notifications (value still stored).
 * @retval <0         bt_gatt_notify() error.
 */
int counter_notify(uint8_t value);

#endif /* GATT_SVC_H_ */
```
