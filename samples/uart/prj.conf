## CMakeLists.txt
```
# SPDX-License-Identifier: Apache-2.0

cmake_minimum_required(VERSION 3.20.0)

# Make the repo-root custom boards (nx15, nx40) discoverable.
list(APPEND BOARD_ROOT ${CMAKE_CURRENT_SOURCE_DIR}/../..)

find_package(Zephyr REQUIRED HINTS $ENV{ZEPHYR_BASE})
project(uart)

target_sources(app PRIVATE src/main.c)
```

## sample.yaml
```
sample:
  name: UART smoke test
  description: |
    UART smoke test. Emits a TX heartbeat over the board
    console UART and echoes back any received bytes, so both directions of
    the UART can be verified with a serial terminal at 115200 8N1.
tests:
  sample.korlinx.uart:
    harness: console
    platform_allow:
      - nx15/nrf54l15/cpuapp
      - nx40/nrf52840
    harness_config:
      type: multi_line
      ordered: true
      regex:
        - "Korlinx NX UART test"
        - "uart alive #[0-9]+"
```

## prj.conf
```kconfig
CONFIG_SERIAL=y
CONFIG_UART_INTERRUPT_DRIVEN=y
CONFIG_CONSOLE=y
CONFIG_UART_CONSOLE=y

CONFIG_LOG=y
CONFIG_LOG_BACKEND_UART=y
```

## src/main.c
```c
/*
 * Copyright (c) 2026 Korlinx
 *
 * SPDX-License-Identifier: Apache-2.0
 */

#include <zephyr/kernel.h>
#include <zephyr/device.h>
#include <zephyr/drivers/uart.h>
#include <zephyr/sys/printk.h>

static const struct device *const uart_dev = DEVICE_DT_GET(DT_CHOSEN(zephyr_console));

K_MSGQ_DEFINE(rx_msgq, sizeof(uint8_t), 64, 1);

static void uart_rx_cb(const struct device *dev, void *user_data)
{
	uint8_t c;

	ARG_UNUSED(user_data);

	if (!uart_irq_update(dev)) {
		return;
	}

	while (uart_irq_rx_ready(dev) && uart_fifo_read(dev, &c, 1) == 1) {
		(void)k_msgq_put(&rx_msgq, &c, K_NO_WAIT);
	}
}

int main(void)
{
	int err;

	if (!device_is_ready(uart_dev)) {
		printk("UART device %s not ready\n", uart_dev->name);
		return 0;
	}

	err = uart_irq_callback_user_data_set(uart_dev, uart_rx_cb, NULL);
	if (err) {
		printk("UART interrupt-driven API not supported (err %d)\n", err);
		return 0;
	}
	uart_irq_rx_enable(uart_dev);

	printk("=== Korlinx NX UART test on %s ===\n", CONFIG_BOARD_TARGET);
	printk("console UART: %s  |  115200 8N1\n", uart_dev->name);

	uint32_t count = 0U;
	int64_t next_beat = k_uptime_get();

	while (1) {
		uint8_t c;

		while (k_msgq_get(&rx_msgq, &c, K_NO_WAIT) == 0) {
			uart_poll_out(uart_dev, c);
		}

		if (k_uptime_get() >= next_beat) {
			printk("uart alive #%u\n", count++);
			next_beat += 1000;
		}

		k_sleep(K_MSEC(10));
	}

	return 0;
}
```
