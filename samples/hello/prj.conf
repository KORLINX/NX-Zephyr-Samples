## CMakeLists.txt
```
# SPDX-License-Identifier: Apache-2.0

cmake_minimum_required(VERSION 3.20.0)

# Make the repo-root custom boards (nx15, nx40) discoverable.
list(APPEND BOARD_ROOT ${CMAKE_CURRENT_SOURCE_DIR}/../..)

find_package(Zephyr REQUIRED HINTS $ENV{ZEPHYR_BASE})
project(hello)

target_sources(app PRIVATE src/main.c)
```

## sample.yaml
```
sample:
  name: Hello console
  description: |
    Minimal bring-up sample that prints to the console (UART on nx15,
    USB CDC on nx40) via printk and emits LOG messages to the same
    console.
tests:
  sample.korlinx.hello:
    harness: console
    platform_allow:
      - nx15/nrf54l15/cpuapp
      - nx40/nrf52840
    harness_config:
      type: multi_line
      ordered: true
      regex:
        - "Korlinx NX hello sample"
        - "printk tick #[0-9]+"
```

## prj.conf
```kconfig
CONFIG_LOG=y
CONFIG_LOG_BACKEND_UART=y
```

## src/main.c
```c
/*
 * Copyright (c) 2026 Korlinx
 *
 * SPDX-License-Identifier: Apache-2.0
 */

#include <zephyr/kernel.h>
#include <zephyr/sys/printk.h>
#include <zephyr/logging/log.h>
LOG_MODULE_REGISTER(hello, LOG_LEVEL_INF);

int main(void)
{
	printk("Korlinx NX hello sample on %s\n", CONFIG_BOARD_TARGET);
	LOG_INF("logging is up");

	uint32_t count = 0U;

	while (1) {
		printk("printk tick #%u\n", count);
		LOG_INF("LOG tick #%u", count);
		count++;
		k_sleep(K_MSEC(1000));
	}

	return 0;
}
```
