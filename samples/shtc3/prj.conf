## CMakeLists.txt
```
# SPDX-License-Identifier: Apache-2.0

cmake_minimum_required(VERSION 3.20.0)

# Make the repo-root custom boards (nx15, nx40) discoverable.
list(APPEND BOARD_ROOT ${CMAKE_CURRENT_SOURCE_DIR}/../..)

find_package(Zephyr REQUIRED HINTS $ENV{ZEPHYR_BASE})
project(shtc3)

target_sources(app PRIVATE src/main.c)
```

## sample.yaml
```
sample:
  name: SHTC3 blocking read
  description: |
    Reads the on-board Sensirion SHTC3 (devicetree alias dht0) once per
    second with the blocking sensor API and prints temperature and
    relative humidity on the console (UART on nx15, USB CDC on nx40).
tests:
  sample.korlinx.shtc3:
    harness: console
    tags: sensors
    platform_allow:
      - nx15/nrf54l15/cpuapp
      - nx40/nrf52840
    harness_config:
      type: one_line
      regex:
        - "#[0-9]+ temp: (.*) °C, humidity: (.*) %RH"
```

## prj.conf
```kconfig
CONFIG_SENSOR=y
CONFIG_CBPRINTF_FP_SUPPORT=y

# The console and the log go to the board console: USB CDC ACM on nx40,
# UART20 on nx15.
CONFIG_LOG=y
CONFIG_LOG_BACKEND_UART=y
```

## src/main.c
```c
/*
 * Copyright (c) 2026 Korlinx
 *
 * SPDX-License-Identifier: Apache-2.0
 */

#include <zephyr/device.h>
#include <zephyr/drivers/sensor.h>
#include <zephyr/kernel.h>
#include <zephyr/logging/log.h>

LOG_MODULE_REGISTER(shtc3_sample, LOG_LEVEL_INF);

#define SAMPLE_PERIOD_MS 1000

/* The NX boards alias the on-board SHTC3 as dht0. */
static const struct device *const shtc3 = DEVICE_DT_GET(DT_ALIAS(dht0));

static int read_shtc3(struct sensor_value *temp, struct sensor_value *hum)
{
	int rc;

	/* The driver wakes the sensor, measures, then puts it back to sleep. */
	rc = sensor_sample_fetch(shtc3);
	if (rc != 0) {
		return rc;
	}

	rc = sensor_channel_get(shtc3, SENSOR_CHAN_AMBIENT_TEMP, temp);
	if (rc != 0) {
		return rc;
	}

	return sensor_channel_get(shtc3, SENSOR_CHAN_HUMIDITY, hum);
}

int main(void)
{
	uint32_t count = 0U;

	if (!device_is_ready(shtc3)) {
		LOG_ERR("%s is not ready, check the I2C wiring and power", shtc3->name);
		return 0;
	}

	LOG_INF("Reading %s every %d ms", shtc3->name, SAMPLE_PERIOD_MS);

	while (true) {
		struct sensor_value temp;
		struct sensor_value hum;
		int rc;

		rc = read_shtc3(&temp, &hum);
		if (rc != 0) {
			LOG_ERR("Reading %s failed: %d", shtc3->name, rc);
		} else {
			printk("#%u temp: %.2f °C, humidity: %.2f %%RH\n", ++count,
			       sensor_value_to_double(&temp), sensor_value_to_double(&hum));
		}

		k_msleep(SAMPLE_PERIOD_MS);
	}

	return 0;
}
```
