/*
 * Copyright (c) 2024 Nordic Semiconductor ASA
 * Copyright (c) 2026 Korlinx
 *
 * SPDX-License-Identifier: LicenseRef-Nordic-5-Clause
 */

/ {
	chosen {
		ncs,dtm-uart = &board_cdc_acm_uart;
	};
};

&board_cdc_acm_uart {
	current-speed = <19200>;
};
