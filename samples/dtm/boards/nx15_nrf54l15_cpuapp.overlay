/*
 * Copyright (c) 2024 Nordic Semiconductor ASA
 * Copyright (c) 2026 Korlinx
 *
 * SPDX-License-Identifier: LicenseRef-Nordic-5-Clause
 */

/ {
	chosen {
		ncs,dtm-uart = &uart20;
	};
};

&uart20 {
	status = "okay";
	current-speed = <19200>;
};

&radio {
	/delete-property/ dfe-supported;
};
