## boards/korlinx/nx40/Kconfig
```kconfig
# Copyright (c) 2026 Korlinx
# SPDX-License-Identifier: Apache-2.0

config BOARD_NX40_UF2_1200BPS_TOUCH
	bool "Reboot into the UF2 bootloader on a 1200 bps touch"
	default y
	depends on CDC_ACM_SERIAL_INITIALIZE_AT_BOOT
	select UART_LINE_CTRL
	help
	  Reboot into the KORLINX nRF52 Bootloader (UF2 mode) when the host
	  opens the USB CDC ACM console at 1200 bps and then closes it, the
	  same "1200 bps touch" the Arduino IDE uses. The board writes 0x57 to
	  GPREGRET, which the bootloader checks on reset.
```

## boards/korlinx/nx40/Kconfig.defconfig
```kconfig
# Copyright (c) 2026 Korlinx
# SPDX-License-Identifier: Apache-2.0

if BOARD_NX40

config HW_STACK_PROTECTION
	default ARCH_HAS_STACK_PROTECTION

config USE_DT_CODE_PARTITION
	default y

source "boards/common/usb/Kconfig.cdc_acm_serial.defconfig"

if CDC_ACM_SERIAL_INITIALIZE_AT_BOOT

config CDC_ACM_SERIAL_MANUFACTURER_STRING
	default "KORLINX"

config CDC_ACM_SERIAL_PRODUCT_STRING
	default "NX40 nRF52840"

config CDC_ACM_SERIAL_VID
	default 0x1209

config CDC_ACM_SERIAL_PID
	default 0x4E58

endif # CDC_ACM_SERIAL_INITIALIZE_AT_BOOT

endif # BOARD_NX40
```

## boards/korlinx/nx40/Kconfig.nx40
```kconfig
# Copyright (c) 2026 Korlinx
# SPDX-License-Identifier: Apache-2.0

config BOARD_NX40
	select SOC_NRF52840_QIAA if BOARD_NX40_NRF52840
```

## boards/korlinx/nx40/Kconfig.sysbuild
```kconfig
# Copyright (c) 2026 Korlinx
# SPDX-License-Identifier: Apache-2.0

if BOARD_NX40

config PARTITION_MANAGER
	default n

endif # BOARD_NX40
```

## boards/korlinx/nx40/board.yml
```yaml
board:
  name: nx40
  full_name: Korlinx NX (nRF52840)
  vendor: korlinx
  socs:
    - name: nrf52840
```

## boards/korlinx/nx40/nx40_nrf52840_defconfig
```kconfig
# Copyright (c) 2026 Korlinx
# SPDX-License-Identifier: Apache-2.0

# Enable MPU
CONFIG_ARM_MPU=y

# Enable GPIO
CONFIG_GPIO=y

CONFIG_SERIAL=y
CONFIG_CONSOLE=y
CONFIG_UART_CONSOLE=y

CONFIG_BUILD_OUTPUT_UF2=y
```

## samples/direct_test_mode/sample.yaml
```yaml
sample:
  name: Direct Test Mode
  description: |
    Bluetooth LE Direct Test Mode over the two-wire UART interface
    (19200 baud) for RF testing.
tests:
  sample.korlinx.direct_test_mode:
    sysbuild: true
    build_only: true
    tags: bluetooth
    platform_allow:
      - nx15/nrf54l15/cpuapp
      - nx40/nrf52840
```

## samples/dm/sample.yaml
```yaml
sample:
  name: nRF Distance Measurement (nrf_dm)
  description: |
    Distance measurement between two devices using the nrf_dm library over
    the 2.4 GHz radio (RTT + MCPD). nx40 (nRF52840) only -- the nrf_dm library
    is not prebuilt for nRF54L, so nx15 is unsupported. Flash two boards and
    watch the estimated distance in the log.
tests:
  sample.korlinx.dm:
    sysbuild: true
    build_only: true
    tags: bluetooth
    platform_allow:
      - nx40/nrf52840
```

## samples/dtm/sample.yaml
```yaml
sample:
  name: Direct Test Mode
  description: |
    Bluetooth LE Direct Test Mode over the two-wire UART interface
    (19200 baud) for RF testing.
tests:
  sample.korlinx.dtm:
    sysbuild: true
    build_only: true
    tags: bluetooth
    platform_allow:
      - nx15/nrf54l15/cpuapp
      - nx40/nrf52840
```

## samples/imu_lsm6d/sample.yaml
```yaml
sample:
  name: LSM6DSL IMU
  description: |
    Reads accelerometer and gyroscope data from the on-board LSM6DSL over
    I2C, first in data-ready trigger mode and then in polling mode.
tests:
  sample.korlinx.imu_lsm6d:
    harness: console
    tags: sensors
    timeout: 15
    platform_allow:
      - nx15/nrf54l15/cpuapp
      - nx40/nrf52840
    harness_config:
      type: multi_line
      ordered: true
      regex:
        - "accel x:[-.0-9]* ms/2 y:[-.0-9]* ms/2 z:[-.0-9]* ms/2"
        - "gyro x:[-.0-9]* rad/s y:[-.0-9]* rad/s z:[-.0-9]* rad/s"
        - "trig_cnt:[0-9]*"
```

## samples/micro_msm261d35/sample.yaml
```yaml
sample:
  name: MSM261D3526 PDM microphone
  description: |
    Captures PCM buffers from the on-board MSM261D3526 PDM microphone via the
    Zephyr DMIC API, in mono and stereo configurations. nx40 only (nx15 has
    no PDM microphone wired).
tests:
  sample.korlinx.micro_msm261d35:
    tags: dmic
    platform_allow:
      - nx40/nrf52840
    harness: console
    harness_config:
      type: multi_line
      ordered: true
      regex:
        - "DMIC sample"
        - "Exiting"
```

## samples/rssi_power_control/central/sample.yaml
```yaml
sample:
  name: RSSI and power control (central)
  description: |
    The central side of a two-board Bluetooth LE Power Control demonstration.
tests:
  sample.korlinx.rssi_power_control.central:
    sysbuild: true
    build_only: true
    tags: bluetooth
    platform_allow:
      - nx15/nrf54l15/cpuapp
      - nx40/nrf52840
```

## samples/rssi_power_control/peripheral/sample.yaml
```yaml
sample:
  name: RSSI and power control (peripheral)
  description: |
    The peripheral side of a two-board Bluetooth LE Power Control demonstration.
tests:
  sample.korlinx.rssi_power_control.peripheral:
    sysbuild: true
    build_only: true
    tags: bluetooth
    platform_allow:
      - nx15/nrf54l15/cpuapp
      - nx40/nrf52840
```
